## firmware/esp32-csi-node/sdkconfig.defaults
```kconfig
CONFIG_IDF_TARGET="esp32s3"
CONFIG_ESP_WIFI_CSI_ENABLED=y
CONFIG_ESP_WIFI_ENABLED=y
CONFIG_LWIP_IPV4=y

# Logging
CONFIG_LOG_DEFAULT_LEVEL_INFO=y
```
